## app/Launcher/Config.in
```kconfig
menuconfig KB_examples_projects_mobile_kpa_Launcher
	bool "Launcher Flutter Application"
	depends on KB_TARGET_arm_kos    \
	        || KB_TARGET_arm64_kos  \
	        || KB_TARGET_i686_kos   \
	        || KB_TARGET_x86_64_kos
	default n

if KB_examples_projects_mobile_kpa_Launcher

#define NAME examples_projects_mobile_kpa_Launcher
#include <package.internal.in>

config PACKAGE_PROPERTY(PREFIX)
	string
	default "$(EXAMPLES_PREFIX_DIR)/mobile/kpa/Launcher"

endif
```

## app/MyPhone/Config.in
```kconfig
menuconfig KB_examples_projects_mobile_kpa_my_phone
	bool "MyPhone"
	depends on KB_TARGET_arm_kos    \
	        || KB_TARGET_arm64_kos  \
	        || KB_TARGET_i686_kos   \
	        || KB_TARGET_x86_64_kos
	default n

if KB_examples_projects_mobile_kpa_my_phone

#define NAME examples_projects_mobile_kpa_my_phone
#include <package.internal.in>

config PACKAGE_PROPERTY(PREFIX)
	string
	default "$(EXAMPLES_PREFIX_DIR)/mobile/kpa/my_phone"

endif
```

## app/Radio2/Config.in
```kconfig
menuconfig KB_examples_projects_mobile_kpa_Radio2
	bool "Radio2 Flutter Application"
	depends on KB_TARGET_arm_kos    \
	        || KB_TARGET_arm64_kos  \
	        || KB_TARGET_i686_kos   \
	        || KB_TARGET_x86_64_kos
	default n

if KB_examples_projects_mobile_kpa_Radio2

#define NAME examples_projects_mobile_kpa_Radio2
#include <package.internal.in>

config PACKAGE_PROPERTY(PREFIX)
	string
	default "$(EXAMPLES_PREFIX_DIR)/mobile/kpa/Radio2"

endif
```

## app/Reminders/Config.in
```kconfig
menuconfig KB_examples_projects_mobile_kpa_Reminders
	bool "Reminders Flutter Application"
	depends on KB_TARGET_arm_kos    \
	        || KB_TARGET_arm64_kos  \
	        || KB_TARGET_i686_kos   \
	        || KB_TARGET_x86_64_kos
	default n

if KB_examples_projects_mobile_kpa_Reminders

#define NAME examples_projects_mobile_kpa_Reminders
#include <package.internal.in>

config PACKAGE_PROPERTY(PREFIX)
	string
	default "$(EXAMPLES_PREFIX_DIR)/mobile/kpa/Reminders"

endif
```

## rules/minimal_flutter/Config.in
```kconfig
menuconfig KB_examples_projects_mobile_kpa_minimal_flutter
	bool "Flutter Application"
	depends on KB_TARGET_arm_kos    \
	        || KB_TARGET_arm64_kos  \
	        || KB_TARGET_i686_kos   \
	        || KB_TARGET_x86_64_kos
	default n

if KB_examples_projects_mobile_kpa_minimal_flutter

#define NAME examples_projects_mobile_kpa_minimal_flutter
#include <package.internal.in>

config PACKAGE_PROPERTY(PREFIX)
	string
	default "$(EXAMPLES_PREFIX_DIR)/mobile/kpa/minimal_flutter"

endif
```
